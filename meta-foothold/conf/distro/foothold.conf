## meta-foothold/conf/distro/foothold.conf
```bitbake
# SPDX-License-Identifier: MIT
require conf/distro/poky.conf

DISTRO = "foothold"
DISTROOVERRIDES = "poky:foothold"

# Use our own kernel
PREFERRED_PROVIDER_virtual/kernel = "linux-foothold"

hostname_pn-base-files = "${DISTRO}"

COMPATIBLE_MACHINE = "fharm64"

DISTRO_EXTRA_RDEPENDS_append_foothold = " ${POKYQEMUDEPS}"

# If you need any of these, re-enable...
DISTRO_FEATURES_remove = " 3g bluetooth irda x11 wayland bluez5 opengl vulkan"
```

## meta-foothold/conf/layer.conf
```bitbake
# SPDX-License-Identifier: MIT

BBPATH .= ":${LAYERDIR}"
BBFILES += "${LAYERDIR}/recipes-*/*/*.bb"
BBFILES += "${LAYERDIR}/recipes-*/*/*.bbappend"

BBFILE_COLLECTIONS += "foothold"
BBFILE_PATTERN_foothold = "^${LAYERDIR}/"
BBFILE_PRIORITY_foothold = "10"

LAYERVERSION_foothold = "1"
LAYERDEPENDS_foothold = "core"
LAYERSERIES_COMPAT_foothold = "zeus"

USER_CLASSES += "foothold-off-tree-headers"
```

## meta-foothold/conf/machine/fharm64.conf
```bitbake
# SPDX-License-Identifier: MIT
#@TYPE: Machine
#@NAME: fharm64
##@DESCRIPTION: ARM AArch64 armv8 QEMU dev board

require conf/machine/include/arm/arch-armv8.inc
require conf/machine/include/qemu.inc

# Reduce useless machine features
MACHINE_FEATURES = ""

KERNEL_IMAGETYPE = "Image"
KERNEL_ALT_IMAGETYPE = "vmlinux"

SERIAL_CONSOLES ?= "38400;ttyAMA0 38400;hvc0"

COMPATIBLE_MACHINE = "fharm64"
MACHINEOVERRIDES_append = "fharm64:"

ARCH = "arm64"
KARCH = "arm64"

# Settings for QEMU
# Pretty much standard, but have it here for configurability.
# We do add SMP so we have 2 x A53 cores.
QB_SYSTEM_NAME = "qemu-system-aarch64"
QB_MEM = "-m 512"
QB_MACHINE = "-machine virt"
QB_CPU = "-cpu cortex-a53"
QB_KERNEL_CMDLINE_APPEND = "console=ttyAMA0,38400"
# Add the 'virtio-rng-pci' device otherwise the guest may run out of entropy
QB_OPT_APPEND = "-show-cursor -device virtio-rng-pci -monitor null -smp 2"
QB_TAP_OPT = "-netdev tap,id=net0,ifname=@TAP@,script=no,downscript=no"
QB_NETWORK_DEVICE = "-device virtio-net-device,netdev=net0,mac=@MAC@"
QB_ROOTFS_OPT = "-drive id=disk0,file=@ROOTFS@,if=none,format=raw -device virtio-blk-device,drive=disk0"
QB_SERIAL_OPT = "-device virtio-serial-device -chardev null,id=virtcon -device virtconsole,chardev=virtcon"
QB_TCPSERIAL_OPT = " -device virtio-serial-device -chardev socket,id=virtcon,port=@PORT@,host=127.0.0.1 -device virtconsole,chardev=virtcon"
```
